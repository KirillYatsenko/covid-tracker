## main/Kconfig.projbuild
```kconfig
menu "COVID19"

config SSID
    string "Wi-Fi name (SSID)"
    
config PASSWORD
    string "Wi-Fi password"
    
config COUNTRY
    string "Country name"
    default "ukraine"

endmenu
```
